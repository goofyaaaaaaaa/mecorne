/*
 * Copyright (c) 2020 The ZMK Contributors
 *
 * SPDX-License-Identifier: MIT
 */

#include <behaviors.dtsi>
#include <dt-bindings/zmk/keys.h>
#include <dt-bindings/zmk/bt.h>


/ {
        keymap {
                compatible = "zmk,keymap";

                default_layer {
// -----------------------------------------------------------------------------------------
// |  ESC |  Q  |  W  |  E  |  R  |  T  |   |  Y  |  U   |  I  |  O  |  P  | BKSP |
// | TAB |  A  |  S  |  D  |  F  |  G  |   |  H  |  J   |  K  |  L  |  /  |  ENT   |
// | CTRL |  Z  |  X  |  C  |  c  |  V  |   |  B  |  N   |  M  |  ,  |  .  | '  |
//                    | SHFT | ALT | LWR |   | SPC | RSE  | PSCRN |
                        bindings = <
   &kp ESC   &kp Q &kp W &kp E &kp R &kp T   &kp Y &kp U  &kp I     &kp O   &kp P    &kp BSPC
   &kp TAB &kp A &kp S &kp D &kp F &kp G   &kp H &kp J  &kp K     &kp L   &kp FSLH &kp RET
   &kp LCTRL &kp Z &kp X &kp C &kp C &kp V   &kp B &kp N  &kp M &kp COMMA &kp DOT &kp SQT
                &kp LSHFT &kp RALT &mo 1   &kp SPACE &mo 2 &kp PSCRN
                        >;
                };
                lower_layer {
// -----------------------------------------------------------------------------------------
// |  TAB |  ! |  @  |  1  |  2  |  3  |   |    |    |    |  |    | BKSP |
// | BTCLR| BT1 | BT2 | 4 | 5 | 6 |   |    |   |  |   |  |   ENT   |
// | SHFT |     |     |  7   |  8   |  9   |   |   UP  |   UP  |     |     |    " |  ?    |
//                    | GUI |     | SPC |   | LFT |   DWN  | RGT |
                        bindings = <
   &kp TAB    &kp EXCL       &kp AT       &kp N1       &kp N2       &kp N3         &kp N6   &kp N7   &kp N8 &kp N9    &kp N0 &kp BSPC
   &bt BT_CLR &bt BT_SEL 0 &bt BT_SEL 1 &kp N4      &kp N5         &kp N6   &kp LEFT &kp DOWN &kp UP &kp RIGHT &kp PIPE &kp RET
   &kp LSHFT  &trans       &trans       &kp N7       &kp N8       &kp N9         &kp UP   &kp UP   &trans &trans    &kp DQT &kp QMARK
                                    &kp LGUI     &trans  &trans     &kp LEFT      &kp DOWN  &kp RIGHT   
                        >;
                };

                raise_layer {
// -----------------------------------------------------------------------------------------
// |  TAB |  !  |  @  |  #  |  $  |  %  |   |  ^  |  &  |  *  |  (  |  )  | BKSP |
// | CTRL |   ~  |  `   |     |     |     |   |  -  |  =  |  [  |  ]  |  \  |  ?   |
// | SHFT |     |     |     |     |     |   |  _  |  +  |  {  |  }  | "|" |  ENT   |
//                    | GUI |     | SPC |   | PSCRN  |     | ALT |
                        bindings = <
   &kp  TAB  &kp EXCL &kp AT &kp HASH &kp DLLR &kp PRCNT   &kp CARET &kp AMPS  &kp KP_MULTIPLY &kp LPAR &kp RPAR &kp BSPC
   &kp LCTRL &kp TILDE   &kp GRAVE &trans   &trans   &trans      &kp MINUS &kp EQUAL &kp LBKT        &kp RBKT &kp BSLH &kp QMARK
   &kp LSHFT &trans   &trans &trans   &trans   &trans      &kp UNDER &kp PLUS  &kp LBRC        &kp RBRC &kp PIPE &kp RET
                             &kp LGUI &trans   &kp SPACE   &kp PSCRN   &trans    &kp RALT
                        >;
                };
        };
};


#ifdef OLED_ENABLE

// Rotate OLED
oled_rotation_t oled_init_user(oled_rotation_t rotation) {
    return OLED_ROTATION_90; 

// Draw to OLED
bool oled_task_user() {
    // Set cursor position
    oled_set_cursor(0, 1);

static void render_logo(void) {
    static const char PROGMEM my_logo[] = {
    // 'huoran', 32x128px
    0x00, 0x00, 0x10, 0xaa, 0x01, 0xc0, 0x09, 0x55, 0x07, 0x60, 0x02, 0xaa, 0x04, 0x38, 0x03, 0x55, 
    0x0c, 0x0d, 0x16, 0xaa, 0x38, 0x06, 0xa5, 0x55, 0x68, 0x04, 0x86, 0xaa, 0x40, 0x00, 0x85, 0x55, 
    0x40, 0x00, 0x86, 0xaa, 0x7f, 0xff, 0x85, 0x55, 0x00, 0x00, 0x06, 0xaa, 0x00, 0x00, 0x03, 0x55, 
    0x00, 0x00, 0x02, 0xaa, 0x00, 0x00, 0x05, 0x55, 0x00, 0x00, 0x08, 0xaa, 0x00, 0x00, 0x00, 0xd5, 
    0x18, 0xc0, 0x00, 0x6a, 0x25, 0x20, 0x00, 0x35, 0x42, 0x10, 0x00, 0x0e, 0x00, 0x00, 0x00, 0x41, 
    0x00, 0x00, 0x00, 0x80, 0x00, 0x00, 0x00, 0x04, 0x00, 0x00, 0x00, 0x08, 0x00, 0x00, 0x00, 0x00, 
    0x00, 0x00, 0x00, 0x00, 0x00, 0x00, 0x00, 0x00, 0x00, 0x00, 0x00, 0x00, 0x00, 0x00, 0x00, 0x88, 
    0x00, 0x00, 0x00, 0x50, 0x00, 0x00, 0x00, 0x20, 0x00, 0x00, 0x00, 0x00, 0x00, 0x00, 0x00, 0x00, 
    0x00, 0x00, 0x00, 0x00, 0x00, 0x03, 0xc0, 0x00, 0x00, 0x07, 0xe0, 0x00, 0x00, 0x0f, 0xf0, 0x00, 
    0x00, 0x1e, 0xf8, 0x00, 0x00, 0x3d, 0x7c, 0x00, 0x00, 0x7a, 0xbe, 0x00, 0x00, 0xf5, 0x5f, 0x00, 
    0x01, 0xea, 0xaf, 0x80, 0x03, 0xd5, 0x57, 0xc0, 0x07, 0xaa, 0xab, 0xe0, 0x2f, 0xff, 0xff, 0xf0, 
    0x4f, 0xff, 0xff, 0xf0, 0x27, 0xff, 0xff, 0xe0, 0x13, 0x80, 0x03, 0xc0, 0x23, 0xc0, 0x07, 0xc0, 
    0x43, 0xff, 0xff, 0xc0, 0x23, 0xff, 0xff, 0xc0, 0x53, 0xff, 0xff, 0xc0, 0x73, 0xff, 0xff, 0xc0, 
    0x73, 0xff, 0xff, 0xc0, 0x73, 0xff, 0xff, 0xc0, 0x73, 0xe0, 0x07, 0xc0, 0x73, 0xef, 0xf7, 0xc0, 
    0x73, 0xef, 0xd7, 0xc0, 0x73, 0xef, 0xf7, 0xc0, 0x7f, 0xef, 0xf7, 0xc0, 0x7f, 0xef, 0xf7, 0xc0, 
    0x7f, 0xef, 0xf7, 0xc0, 0x7f, 0xe0, 0x07, 0xc0, 0x03, 0xff, 0xff, 0xc0, 0x03, 0xe0, 0x07, 0xc0, 
    0x03, 0xf0, 0x0f, 0xc0, 0x03, 0xff, 0xff, 0xc0, 0x03, 0xff, 0xff, 0xe0, 0x03, 0x81, 0x81, 0xf0, 
    0x03, 0xbd, 0xbd, 0xf8, 0x03, 0xb5, 0xb5, 0xfc, 0x03, 0xbd, 0xbd, 0xfe, 0x03, 0xbd, 0xbd, 0xc0, 
    0x03, 0x81, 0x81, 0xc0, 0x03, 0xff, 0xff, 0xc0, 0x03, 0x81, 0x81, 0xc0, 0x03, 0xc3, 0xc3, 0xc0, 
    0x02, 0xff, 0xff, 0x40, 0x02, 0x7e, 0x7e, 0x40, 0x02, 0x00, 0x00, 0x40, 0x03, 0xbf, 0xfd, 0xc0, 
    0x03, 0xbf, 0xfd, 0xc0, 0x03, 0xbf, 0xfd, 0xc0, 0x03, 0xbf, 0xfd, 0xc0, 0x03, 0xb8, 0x1d, 0xc0, 
    0x03, 0xbb, 0xdd, 0xc0, 0x03, 0xbb, 0x5d, 0xc0, 0x03, 0xbb, 0xdd, 0xc0, 0x03, 0xbb, 0xdd, 0xc0, 
    0x03, 0xbb, 0xdd, 0xc0, 0x03, 0xbb, 0xdd, 0xc0, 0x03, 0xbb, 0xdd, 0xc0, 0x03, 0xbb, 0xdd, 0xc0, 
    0x03, 0xbb, 0xdd, 0xc0, 0x03, 0xb8, 0x1d, 0xc0, 0x03, 0xba, 0x9d, 0xc0, 0x03, 0xb9, 0x5d, 0xc0, 
    0x03, 0xba, 0x9d, 0xc4, 0x23, 0xb9, 0x5d, 0xca, 0x53, 0xba, 0x9d, 0xc4, 0x23, 0xb9, 0x5d, 0xc4, 
    0x23, 0xba, 0x9d, 0xc4, 0x23, 0xb9, 0x5d, 0xd4, 0x23, 0xba, 0x9d, 0xec, 0x23, 0xb9, 0x5d, 0xd4, 
    0x23, 0xba, 0x9d, 0xd4, 0x53, 0xb9, 0x5d, 0xd5, 0xa0, 0x00, 0x00, 0x0a, 0x55, 0x55, 0x55, 0x55, 
    0xaa, 0xaf, 0xea, 0xaa, 0x55, 0x54, 0x35, 0x55, 0x00, 0x07, 0xe0, 0x00, 0x10, 0x04, 0x22, 0x00, 
    0x7c, 0xa7, 0xe3, 0xca, 0x55, 0x14, 0x24, 0x48, 0x10, 0x47, 0xea, 0xbe, 0x7c, 0xa4, 0x25, 0x08, 
    0x11, 0x17, 0xe2, 0x14, 0x39, 0xf4, 0x24, 0x22, 0x10, 0x07, 0xe0, 0x00, 0x7d, 0xf4, 0x20, 0x00, 
    0x01, 0x17, 0xe2, 0xa8, 0x7d, 0x14, 0x24, 0x54, 0x45, 0x17, 0xe8, 0x2a, 0x7d, 0xf4, 0x20, 0x00, 
    0x00, 0x07, 0xea, 0xaa, 0x55, 0x54, 0x35, 0x55, 0xaa, 0xaf, 0xea, 0xaa, 0x55, 0x54, 0x35, 0x55
    };
    
    oled_write_raw_P((my_logo), sizeof(my_logo));

        return false; 
}

#endif
